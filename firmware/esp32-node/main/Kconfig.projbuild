## firmware/esp32-node/main/Kconfig.projbuild
```kconfig
# AEDI - IONITY GLOBAL | ESP32-MCP node firmware 3 | Kconfig
# Doc ID: DOC-2026-10-ESP32MCP-FW3 | Policy 986 AED | License AED 900
# (c) 2018-2026 Antwerp Designs | Ionity (Pty) Ltd | Ionity Global (Pty) Ltd

menu "Ionity ESP32-MCP node"

    config IONITY_DEFAULT_HOST_URL
        string "MCP host when none is provisioned"
        default "mqtt://ionity-fleet.local:1883"
        help
            Used when host_url is empty. lwIP resolves *.local names over mDNS
            (LWIP_DNS_SUPPORT_MDNS_QUERIES), as fw 2.x did for ionity-fleet.local.

    config IONITY_JOB_SLOTS
        int "MCP job slots (requests queued + executing)"
        range 1 8
        default 4
        help
            Each slot holds one downlink frame (4 KiB). A request that finds no free
            slot is answered ERR BUSY with retryAfterMs - the network task never waits.

    config IONITY_UPLINK_SLOTS
        int "Uplink frame buffers (2 KiB each)"
        range 4 16
        default 8

    config IONITY_TELEMETRY_PERIOD_S
        int "TELEMETRY period in seconds (0 = off)"
        range 0 3600
        default 10

    config IONITY_TELEMETRY_SECTIONS
        hex "TELEMETRY sections (TelemetrySection bitmask)"
        range 0x00 0xFF
        default 0x3F
        help
            0x01 heap, 0x02 net, 0x04 cpu, 0x08 tasks, 0x10 sensors, 0x20 actuators.

    config IONITY_LED_GPIO
        int "identify LED GPIO (-1 = none, identify not offered)"
        range -1 48
        default 2 if IDF_TARGET_ESP32S3
        default -1

    config IONITY_LED_ACTIVE_HIGH
        bool "identify LED is active high"
        default y

    config IONITY_ADC_GPIO
        int "Analog sense GPIO reported in TELEMETRY sensors.adcMv (-1 = none)"
        range -1 48
        default 3
        help
            fw 2.x analog sense pin (GPIO3 on ESP32-S3 and ESP32-C6, both ADC1).

    config IONITY_SNTP_SERVER
        string "SNTP server (empty = no wall clock; TELEMETRY.unixS absent)"
        default "pool.ntp.org"

    config IONITY_WIFI_POWER_SAVE
        bool "Wi-Fi modem sleep (saves power, adds up to a DTIM interval of latency)"
        default n

    menu "Outputs (set_actuator)"
        config IONITY_PWM0_GPIO
            int "pwm0 GPIO (alert output; -1 = none) when NVS pins{} has none"
            range -1 48
            default 5 if IDF_TARGET_ESP32S3
            default 4 if IDF_TARGET_ESP32C6
            default -1
            help
                fw 2.x default red-light pin (GPIO5 on ESP32-S3). NetObserve pulses it on a flagged
                ALERT match. Strapping / flash / PSRAM / USB / console pins are refused at boot.

        config IONITY_PWM1_GPIO
            int "pwm1 GPIO (-1 = none)"
            range -1 48
            default 6 if IDF_TARGET_ESP32S3
            default 5 if IDF_TARGET_ESP32C6
            default -1

        config IONITY_RELAY0_GPIO
            int "relay0 GPIO (-1 = none)"
            range -1 48
            default 7 if IDF_TARGET_ESP32S3
            default 18 if IDF_TARGET_ESP32C6
            default -1
    endmenu

    menu "NetObserve (LAN DNS forwarder)"
        config IONITY_DNS_BATCH_PERIOD_S
            int "DNS_BATCH period in seconds (earlier when the log is 75 % full)"
            range 2 300
            default 10

        config IONITY_DNS_ALERT_HOLD_S
            int "Alert output stays on this long after the last watched lookup (s)"
            range 1 3600
            default 20

        config IONITY_DNS_CACHE_ENTRIES
            int "Answer cache entries (512 B each)"
            range 1 256
            default 48 if SPIRAM
            default 24

        config IONITY_DNS_LOG_BYTES
            int "Query log ring (bytes; a query costs ~35-60 B)"
            range 2048 131072
            default 16384 if SPIRAM
            default 6144

        config IONITY_DNS_PENDING
            int "Queries in flight upstream"
            range 4 64
            default 24
    endmenu

endmenu
```
